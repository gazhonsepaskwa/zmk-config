&i2c1 {
    status = "okay";
    epaper: ssd1680@3c {
        compatible = "solomon,ssd1680";
        reg = <0x3c>;
        width = <128>;
        height = <64>;
        pp-width-pixels = <128>;
        pp-height-pixels = <64>;
        reset-gpios = <&gpio0 9 GPIO_ACTIVE_LOW>;
        dc-gpios = <&gpio0 10 GPIO_ACTIVE_LOW>;
        busy-gpios = <&gpio0 11 GPIO_ACTIVE_LOW>;
        segment-offset = <0>;
        display-offset = <0>;
    };
};
